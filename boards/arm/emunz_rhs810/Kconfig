## boards/arm/emunz_rhs810/Kconfig
```kconfig
# Rizzler Hall Sensor board configuration

# Copyright (c) 2024 Mr E Munz
# All rights reserved

if BOARD_EMUNZ_RHS810

config BOARD_ENABLE_DCDC
	bool "DCDC mode"
	select SOC_DCDC_NRF52X
	default y

# BT_CTLR depends on BT. When BT is enabled we should default to also
# enabling the controller.
config BT_CTLR
	default y if BT

endif # BOARD_EMUNZ_RHS810
```

## boards/arm/emunz_rhs810/Kconfig.board
```kconfig
# Rizzler Hall Sensor board configuration

# Copyright (c) 2024 Mr E Munz
# All rights reserved

config BOARD_EMUNZ_RHS810
	bool "E Money Rizzler Hall Sensor Board (nRF52810)"
	depends on SOC_NRF52810_QFAA
```

## boards/arm/emunz_rhs810/Kconfig.defconfig
```kconfig
# Rizzler Hall Sensor board configuration

# Copyright (c) 2024 Mr E Munz
# All rights reserved

if BOARD_EMUNZ_RHS810

config BOARD
	default "emunz_rhs810"

endif # BOARD_EMUNZ_RHS810
```

## boards/arm/emunz_rhs810/emunz_rhs810_defconfig
```kconfig
# Copyright (c) 2024 Mr E Munz
# All rights reserved

CONFIG_SOC_SERIES_NRF52X=y
CONFIG_SOC_NRF52810_QFAA=y
CONFIG_BOARD_EMUNZ_RHS810=y

# Enable MPU
CONFIG_ARM_MPU=y

# Enable hardware stack protection
CONFIG_HW_STACK_PROTECTION=y

# enable GPIO
CONFIG_GPIO=y

# Enable UARTE
CONFIG_SERIAL=y

# enable console
CONFIG_CONSOLE=y
CONFIG_UART_CONSOLE=y

# Bluetooth not enabled by default on nRF52810 due to RAM limitations when
# running the default set of kernel tests.
# Enable this on your prj.conf to include Bluetooth support

# additional board options
CONFIG_GPIO_AS_PINRESET=n
CONFIG_PINCTRL=y
```

## west.yml
```yaml
manifest:
  self:
    path: firmware

  remotes:
    - name: zephyrproject-rtos
      url-base: https://github.com/zephyrproject-rtos

  projects:
    - name: zephyr
      remote: zephyrproject-rtos
      revision: zephyr-v3.5.0
      import:
        name-allowlist:
          - mbedtls
          - cmsis
          - hal_nordic
          - littlefs
          - mcuboot
          - mcumgr
          - net-tools
          - segger
          - tinycrypt
          - tinycbor
          - mipi-sys-t
          - nrf_hw_models
          - TraceRecorderSource
          - edtt
```
